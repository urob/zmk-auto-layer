/*
 * Copyright (c) 2024 The ZMK Contributors
 *
 * SPDX-License-Identifier: MIT
 */

#include <dt-bindings/zmk/behaviors.h>
#include <dt-bindings/zmk/keys.h>

/ {
    behaviors {
#if ZMK_BEHAVIOR_OMIT(NUM_WORD)
        /omit-if-no-ref/
#endif
        num_word: num_word {
            compatible = "zmk,behavior-auto-layer";
            #binding-cells = <1>;
            continue-list = <BACKSPACE DELETE DOT COMMA PLUS MINUS STAR FSLH EQUAL>;
            ignore-numbers;
        };
    };
};
