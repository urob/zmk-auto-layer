## dts/bindings/behaviors/zmk,behavior-auto-layer.yaml
```yaml
# Copyright (c) 2024 The ZMK Contributors
# SPDX-License-Identifier: MIT

description: Auto layer behavior

compatible: "zmk,behavior-auto-layer"

include: one_param.yaml

properties:
  continue-list:
    type: array
    required: true
    description: |
      List of key codes which should continue the auto layer behavior.
      If any of the ignore- options are set, this list will be applied
      in addition to them.
  ignore-alphas:
    type: boolean
    description: Continue auto layer behavior for all alpha keys.
  ignore-numbers:
    type: boolean
    description: Continue auto layer behavior for all numbers.
  ignore-modifiers:
    type: boolean
    description: Continue auto layer behavior for all modifiers.
```

## dts/bindings/behaviors/zmk,behavior-ruen-key.yaml
```yaml
description: RuEn key behavior

compatible: "zmk,behavior-ruen-key"

include: two_param.yaml
```

## dts/bindings/behaviors/zmk,behavior-ruen-macos.yaml
```yaml
description: RuEn macos mode switch behavior

compatible: "zmk,behavior-ruen-macos"

include: one_param.yaml
```

## dts/bindings/behaviors/zmk,behavior-ruen-one-key.yaml
```yaml
description: RuEn one-key behavior

compatible: "zmk,behavior-ruen-one-key"

include: two_param.yaml

properties:
  to_en:
    type: int
    required: true
    description: To English hotkey
  to_ru:
    type: int
    required: true
    description: To Russian hotkey
```

## dts/bindings/behaviors/zmk,behavior-ruen-switch.yaml
```yaml
description: RuEn lang switch behavior

compatible: "zmk,behavior-ruen-switch"

include: two_param.yaml
```

## dts/bindings/behaviors/zmk,behavior-ruen-test.yaml
```yaml
description: RuEn macos test behavior

compatible: "zmk,behavior-ruen-test"

include: two_param.yaml
```

## dts/bindings/behaviors/zmk,behavior-ruen.yaml
```yaml
description: RuEn switch behavior

compatible: "zmk,behavior-ruen"

include: one_param.yaml

properties:
  lang-id:
    type: int
    required: true
    description: |
      Language ID to activate when pressed.
```
